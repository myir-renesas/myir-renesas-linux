## Documentation/devicetree/bindings/remoteproc/renesas,rz-rproc.yaml
```yaml
# SPDX-License-Identifier: (GPL-2.0 OR BSD-2-Clause)
%YAML 1.2
---
$id: "http://devicetree.org/schemas/remoteproc/renesas,rz-rproc.yaml#"
$schema: "http://devicetree.org/meta-schemas/core.yaml#"

title: Renesas RZ remote processor controller bindings

description:
  This document defines the binding for the remoteproc component that loads and
  boots firmwares on the RZ/T2H chipset.

properties:
  compatible:
    const: renesas,rz

  reg:
    description:
      Address ranges of the SRAM and DDR memories used by the remote
      processor.
    maxItems: 3

  reg-names:
    maxItems: 3

  memory-region:
    description:
      List of phandles to the reserved memory regions associated with the
      remoteproc device. This is variable and describes the memories shared with
      the remote processor (e.g. remoteproc firmware and carveouts, rpmsg
      vrings, ...).
      (see ../reserved-memory/reserved-memory.txt)

  renesas,rz-autoboot:
    $ref: /schemas/types.yaml#/definitions/flag
    description:
      If defined, when remoteproc is probed, it loads the default firmware and
      starts the remote processor.

  renesas,rz-rsctbl:
    description:
      Physical address of resource table. When remote processor is already powered
      up by u-boot, op-tee..., this value is used to parse the loaded resource table.
    maxItems: 1

  renesas,rz-core:
    description: Select remoteproc core (0x0: CR52 CPU0, 0x1: CR52 CPU1)
    maxItems: 1

  renesas,rz-swint:
    description: Select Non-Safety Software Interrupt channel. It's used to transfer remoteproc core to WFI state
    maxItems: 1

  renesas,rz-start_address:
    description: Select start address (Entry point) of CR52 Firmware (.elf file). 
    maxItems: 1

required:
  - compatible
  - reg
  - memory-region
  - renesas,rz-rsctbl
  - renesas,rz-core
  - renesas,rz-swint
  - renesas,rz-start_address

additionalProperties: false

examples:
  - |
      #include <dt-bindings/interrupt-controller/arm-gic.h>
      #include <dt-bindings/clock/r9a09g077-cpg.h>

      reserved-memory {
        #address-cells = <2>;
        #size-cells = <2>;
        ranges;

        cr52ddr: cr52ddr@3e0000000 {
          compatible = "shared-dma-pool";
          reg = <0x03 0xE0000000 0x0 0x9000000>;
          no-map;
        };

        vdev0vring0: vdev0vring0@0x3E1000000 {
          compatible = "shared-dma-pool";
          reg = <0x3 0xE1000000 0x0 0x50000>;
          no-map;
        };

        vdev0vring1: vdev0vring1@0x3E1050000 {
          compatible = "shared-dma-pool";
          reg = <0x3 0xE1050000 0x0 0x50000>;
          no-map;
        };

        vdev0buffer: vdev0buffer@0x3E1200000 {
          compatible = "shared-dma-pool";
          reg = <0x3 0xE1200000 0x0 0x300000>;
          no-map;
        };
      };

      cr52_0_rproc: cr52_0 {
        compatible = "renesas,rz-cr52";
        reg = <0x0 0x10000000 0x0 0x001FFFFF>,
              <0x3 0xE0000000 0x0 0x09000000>;
        reg-names = "cr52_sram", "cr52_ddr";
        memory-region = <&vdev0vring0>, <&vdev0vring1>, <&vdev0buffer>;
        renesas,rz-core = <0x0>;
        renesas,rz-swint = <10>;
        renesas,rz-rsctbl = <0x3 0xE0000000>;
        renesas,rz-start_address = <0x10061000>;
        status = "okay";
      };

      cr52_1_rproc: cr52_1 {
        compatible = "renesas,rz-cr52";
        reg = <0x0 0x10000000 0x0 0x001FFFFF>,
              <0x3 0xE0000000 0x0 0x09000000>;
        reg-names = "cr52_sram", "cr52_ddr";
        memory-region = <&vdev0vring0>, <&vdev0vring1>, <&vdev0buffer>;
        renesas,rz-core = <0x1>;
        renesas,rz-swint = <11>;
        renesas,rz-rsctbl = <0x3 0xE0000000>;
        renesas,rz-start_address = <0x10061000>;
        status = "okay";
      };
...
```
